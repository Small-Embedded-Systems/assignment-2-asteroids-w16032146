/* Pong Solution:
   Sample solution for the 'Pong' assignment.

   Dr Alun Moon
   Spring 2017
*/

/* C libraries */
#include <stdbool.h>
#include <stdint.h>
#include <LPC407x_8x_177x_8x.h>
#include <LM75B.h>
#include <stdlib.h>
#include <stdint.h>
#include <stdbool.h>
#include <math.h>
#include <string.h>

/* hardware platform libraries */
#include <display.h>
#include <mbed.h>

#include <node.h>

#include <utils.h>

/* SECTION: Graphics related code follows ------------------------------------*/
Display *lcd = Display::theDisplay();

/************************
*Define Controller*
*************************/
typedef enum { left,down,right,up,centre } btnId_t; // 5 way Joystick
DigitalIn joystick[] = {P5_0, P5_1, P5_4, P5_2, P5_3};
DigitalIn userbutton(P2_10,PullUp);



/************************
*Define game coordinates*
*************************/
#define X1_ship_START  150  //X co-ordinate of the position of the ship
#define Y1_ship_START  140 //Y co-ordinate of the position of the ship
#define X2_ship_START  135
#define Y2_ship_START  145
#define X3_ship_START  135
#define Y3_ship_START  135




/***************
*Game state    *
****************/
float elapsed_time; 
int score;
int totalScore;
int lives;
int checker;

float x1Coordinate=X1_ship_START,
			x2Coordinate = X2_ship_START, 
			x3Coordinate = X3_ship_START, 
			y1Coordinate = Y1_ship_START, 
			y2Coordinate = Y2_ship_START, 
			y3Coordinate = Y3_ship_START;
int ship_dx = 0, ship_dy = 0;
const colour_t background = rgb(0,51,102); /* Midnight Blue */
float headingAngle;
float 	xOrigin1 = 10, yOrigin1 = 0, 
		    xOrigin2 = -5, yOrigin2 = 5, 
		    xOrigin3 = -5, yOrigin3 = -5;
float temp;
float differenceX,differenceY;
float relativityIndexX = 1,
			relativityIndexY = 0 ;
float Dt = 0.01f; 


int joystickPress;

bool paused = true;
bool PlayGameFlag = false;
bool shieldActive = false;


Ticker drawing;
Ticker asteroidparticles;
Ticker controller;
Ticker Score;


/*********************
*Function Declations *
**********************/

bool GameOver();
void StartGame();
void Accelarate();
void Decelarate();
void CheckBulletHits();
void CheckAsteroidHit();
void FireBullets();
void drawPlayerShip();
void updateAllPositions();

void Rotation(float RotationAngle);



/*****************
*     BITMAP     *
******************/
const unsigned char myBitmapBitmap [] = {
// 'happyface'
  0x00, 0x00, 0x00, 0x00, 0x00, 0x00, 0x00, 0x00, 0x00, 0x00, 0x00, 0x00, 
  0x00, 0x00, 0x00, 0x00, 0x00, 0x00, 0x00, 0x00, 0x00, 0x00, 0x00, 0x00, 
  0x00, 0x00, 0x00, 0x00, 0x00, 0x00, 0x00, 0x00, 0x00, 0x00, 0x00, 0x00, 
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  0x00, 0x00, 0x00, 0x00, };


/*********************************
*      Function Definitions      *
* ********************************/

bool jsPrsdAndRlsd(btnId_t b) {
	bool result = false;
	uint32_t state;
	static uint32_t savedState[4] = {1,1,1,1};
        //initially all 1s: nothing pressed
	state = joystick[b].read();
  if ((savedState[b] == 0) && (state == 1)) {
		result = true;
	}
	savedState[b] = state;
	return result;
}

bool jsPrsd(btnId_t b) {
	bool result = false;
	uint32_t state;
	state = joystick[b].read();
  if (state == 0) {
		result = true;
	}
	return result;
}


/*********************
*     Physics        *
**********************/
void Accelarate(){	

if(xOrigin1 > 0 && yOrigin1 > 0){
		if(xOrigin1 > yOrigin1){
			relativityIndexY = yOrigin1/xOrigin1;
			relativityIndexX = 1;
		}
		else{
		relativityIndexX = xOrigin1/yOrigin1;
		relativityIndexY = 1;
		}
}
else if( xOrigin1 < 0 && yOrigin1 > 0){
	float testX = xOrigin1 * -1;
		if(testX > yOrigin1){
			relativityIndexY = yOrigin1/testX;
			relativityIndexX = -1;
			
		}
		else{
		relativityIndexX = xOrigin1/yOrigin1;
		relativityIndexY = 1;
		
		}
}
else if( xOrigin1 < 0 && yOrigin1	< 0){
		if(xOrigin1 < yOrigin1){
			relativityIndexY = -(yOrigin1/xOrigin1);
			relativityIndexX = -1;
		}
		else{
		relativityIndexX = -(xOrigin1/yOrigin1);
		relativityIndexY = -1;
		
		}
}
else if( xOrigin1 > 0 && yOrigin1 < 0){
	float testY = yOrigin1 * -1;
		if(xOrigin1 > testY){
			relativityIndexY = yOrigin1/xOrigin1;
			relativityIndexX = 1;
		}
		else{
			relativityIndexX = xOrigin1/testY;
			relativityIndexY = -1;
		
		}
}

else if ( xOrigin1 == 0 && yOrigin1 == 0 ){
   relativityIndexX = 1;
	 relativityIndexY = 0;
}

 x1Coordinate = x1Coordinate + (relativityIndexX)*2;
 y1Coordinate = y1Coordinate + (relativityIndexY)*2;
 x2Coordinate = x2Coordinate + (relativityIndexX)*2;
 y2Coordinate = y2Coordinate + (relativityIndexY)*2;
 x3Coordinate = x3Coordinate + (relativityIndexX)*2;
 y3Coordinate = y3Coordinate + (relativityIndexY)*2;
 

if (x1Coordinate > 470 || x2Coordinate > 470 || x3Coordinate > 470){
	x1Coordinate -= 460;
	x2Coordinate -= 460;
	x3Coordinate -= 460;
}

else if (x1Coordinate < 10 || x2Coordinate < 10 || x3Coordinate < 10){
	x1Coordinate += 460;
	x2Coordinate += 460;
	x3Coordinate += 460;
}


if(y1Coordinate > 270 || y2Coordinate > 270 || y3Coordinate > 270){
	y1Coordinate -= 260;
	y2Coordinate -= 260;
	y3Coordinate -= 260;
}

else if(y1Coordinate < 10 || y2Coordinate < 10 || y3Coordinate < 10){
	y1Coordinate += 260;
	y2Coordinate += 260;
	y3Coordinate += 260;
}
}

void Decelarate(){
 
 	float relativityIndexX, relativityIndexY;
	
if(xOrigin1 > 0 && yOrigin1 > 0){
		if(xOrigin1 > yOrigin1){
			relativityIndexY = yOrigin1/xOrigin1;
			relativityIndexX = -1;
		}
		else{
		relativityIndexX = xOrigin1/yOrigin1;
		relativityIndexY = -1;
		}
}
else if( xOrigin1 < 0 && yOrigin1 > 0){
	float testX = xOrigin1 * -1;
		if(testX > yOrigin1){
			relativityIndexX = (yOrigin1/testX)* -1;
			relativityIndexY = 1;
			
		}
		else{
		relativityIndexY = (testX/yOrigin1);
		relativityIndexX = -1;
		
		}
}
else if( xOrigin1 < 0 && yOrigin1	< 0){ // This does not work.......********......****
		float testX = xOrigin1*-1;
		float testY = yOrigin1*-1;
		if(testX > testY){
			relativityIndexY = (testY/testX);
			relativityIndexX = 1;
		}
		else{
		relativityIndexX = (testX/testY);
		relativityIndexY = 1;
		
		}
}
else if( xOrigin1 > 0 && yOrigin1 < 0){
	float testY = yOrigin1 * -1;
		if(xOrigin1 > testY){
			relativityIndexY = (testY/xOrigin1);
			relativityIndexX = -1;
		}
		else{
			relativityIndexX = -(xOrigin1/testY);
			relativityIndexY = 1;
		
		}
}

else if ( xOrigin1 == 0 && yOrigin1 == 0 ){
   relativityIndexX = 1;
	 relativityIndexY = 0;
}

 x1Coordinate = x1Coordinate + (relativityIndexX)*5;
 y1Coordinate = y1Coordinate + (relativityIndexY)*5;
 x2Coordinate = x2Coordinate + (relativityIndexX)*5;
 y2Coordinate = y2Coordinate + (relativityIndexY)*5;
 x3Coordinate = x3Coordinate + (relativityIndexX)*5;
 y3Coordinate = y3Coordinate + (relativityIndexY)*5;
 
}

void Rotation(float RotationAngle){
	
	float RadianRotationAngle = radiansUtils(RotationAngle);
	
  float dx = (xOrigin1)*cos(RadianRotationAngle) - (yOrigin1)*sin(RadianRotationAngle);
	float dy = (xOrigin1)*sin(RadianRotationAngle) + (yOrigin1)*cos(RadianRotationAngle);

	if(xOrigin1 > dx){
		temp = xOrigin1 - dx;
		xOrigin1 = dx;
		differenceX = temp * -1;
	}
	else{
		temp = dx - xOrigin1;
		xOrigin1 = dx;
		differenceX = temp;
	}
	
	if(yOrigin1 > dy){
		temp =yOrigin1 - dy;
		yOrigin1 = dy;
		differenceY = temp * -1;
	}
	else{
	    temp = dy - yOrigin1;
		  yOrigin1 = dy;
	    differenceY = temp;
	}
  x1Coordinate = x1Coordinate + differenceX;
	y1Coordinate = y1Coordinate + differenceY;
	//X1 Y1 over
	//X2 Y2 start
  dx = (xOrigin2)*cos(RadianRotationAngle) - (yOrigin2)*sin(RadianRotationAngle);
	dy = (xOrigin2)*sin(RadianRotationAngle) + (yOrigin2)*cos(RadianRotationAngle);

	if(xOrigin2 > dx){
		temp = xOrigin2 - dx;
		xOrigin2 = dx;
		differenceX = temp * -1;
	}
	else{
		temp = dx - xOrigin2;
		xOrigin2 = dx;
		differenceX = temp;
	}
	
	if(yOrigin2 > dy){
		temp =yOrigin2 - dy;
		yOrigin2 = dy;
		differenceY = temp * -1;
	}
	else{
	    temp = dy - yOrigin2;
		  yOrigin2 = dy;
	    differenceY = temp;
	}
  x2Coordinate = x2Coordinate + differenceX;
	y2Coordinate = y2Coordinate + differenceY;
	//X2 Y2 over
	//X3 Y3 start
  dx = (xOrigin3)*cos(RadianRotationAngle) - (yOrigin3)*sin(RadianRotationAngle);
	dy = (xOrigin3)*sin(RadianRotationAngle) + (yOrigin3)*cos(RadianRotationAngle);

	if(xOrigin3 > dx){
		temp = xOrigin3 - dx;
		xOrigin3 = dx;
		differenceX = temp * -1;
	}
	else{
		temp = dx - xOrigin3;
		xOrigin3 = dx;
		differenceX = temp;
	}
	
	if(yOrigin3 > dy){
		temp =yOrigin3 - dy;
		yOrigin3 = dy;
		differenceY = temp * -1;
	}
	else{
	  temp = dy - yOrigin3;
	  yOrigin3 = dy;  
		differenceY = temp;
	}
  x3Coordinate = x3Coordinate + differenceX;
	y3Coordinate = y3Coordinate + differenceY;
	
}

void Scoring(){
	score += 1;
	
	switch (score){
        case 10:
					shieldActive = true;
					break;
        case 14:
					shieldActive = false;
					break;
        case 24:
					shieldActive = true;
					break;
        case 28:
					shieldActive = false;
					break;
        case 38:
					shieldActive = true;
					break;
				case 42:
					shieldActive = false;
					break;
        case 52:
					shieldActive = true;
					break;
				case 56:
					shieldActive = false;
					break;
        default:
          //hmmmm
				break;
     }
	
}

void StartGame(){
 PlayGameFlag = true;
 Score.attach(Scoring, 0.8);
 drawPlayerShip();

}

void InitialiseStartingBanner() {
	if(PlayGameFlag == false){
    lcd->drawBitmap(100,100,myBitmapBitmap,182,200,WHITE);
	}
}


void drawPlayerShip(){
	if(shieldActive == false){
	lcd->fillTriangle(x1Coordinate, y1Coordinate, x2Coordinate, y2Coordinate, x3Coordinate, y3Coordinate, WHITE);
	}
	else if(shieldActive == true){
	lcd->fillTriangle(x1Coordinate, y1Coordinate, x2Coordinate, y2Coordinate, x3Coordinate, y3Coordinate, GREEN);
	}
}

void drawBanner() {
			lcd->setTextSize(1);
	    lcd->setTextWrap(background);
	    lcd->setTextColor(WHITE);
			
			//draw score
		  lcd->setCursor(150,2);
			lcd->printf("Score:");
			lcd->setCursor(200,2);	
			lcd->printf("%04d", totalScore);			
			lcd->setCursor(250,2);
			lcd->printf("This Life: %04d", score);
			lcd->setCursor(350,2);	
			lcd->printf("Sheild: Green");
			
			lcd->drawLine(0,15,480,15,BLACK);//TopBorder 
			
			//Lives Left
			lcd->setCursor(10,2);
			lcd->printf("Lives left:");
			lcd->setCursor(145,2);
		  lcd->printf("%d", lives); 
}
/* Setup Double-buffering:
    The LCD display object uses malloc internally, to get enougth memory for
    3 frame buffers.  The display object renders into the buffer supplied
    through setFb, it is returned through getFb.
    The LPC4088 has an LCD driver that displays the contents of the buffer
    supplied through the UPBASE register.
    This function generates a pointer to the second buffer, and sets the
    display to use one, and the driver to use the other.
*/
void init_double_buffering(void)
{
    uint16_t *buffer = lcd->getFb();
    uint16_t *frame2 = buffer+(480*272);
    LPC_LCD->UPBASE = (uint32_t)frame2;
}

/* swap the frame buffers used by the Display GFX library
    and the LCD driver
*/
void swap_double_buffers(void)
{
    unsigned int b;
    b = LPC_LCD->UPBASE;
    LPC_LCD->UPBASE = (uint32_t)lcd->getFb();
    lcd->setFb((uint16_t *)b);
}


/* Draw a list of particles */
void drawBullets(struct bulletStruct *bulletList)
{
    /* while there are particles to draw */
    while(bulletList) {
        lcd->fillCircle(bulletList->x,bulletList->y, 2, BLUE);
        bulletList = bulletList->next;/* itterate along the list */
    }
}

void drawAsteroids(struct asteroidStruct *asteroidList)
{
    /* while there are particles to draw */
    while(asteroidList) {
        lcd->fillCircle(asteroidList->x,asteroidList->y, 10, RED);
        asteroidList = asteroidList->next;/* itterate along the list */
    }
}

/* Initialise the properties of a new particle */
int randrange(int from, int to)
{
    int range = to-from;
    return rand()%range + from;
}
float radians(float a)
{
    const float pi = 3.141592;
    return a * pi /180.0f; 
}
void strikeBullets(struct bulletStruct *r)
{
    r->x = x1Coordinate;
    r->y = y1Coordinate;
    r->v_x = relativityIndexX;
    r->v_y = relativityIndexY;
    r->ttl = 15; /* how long to live (s) */
}

void strikeAsteroids(struct asteroidStruct *r){
	int randomSide = randrange(1,4);
     switch (randomSide){
        case 1:
					r->x = randrange(15,400);
					r->y = randrange(15,20);
					r->v_x = randrange(1,2);
					r->v_y = randrange(1,2);
					r->ttl = 10; /* how long to live (s) */
					break;
        case 2:
					r->x = randrange(10,15);
					r->y = randrange(10,260);
					r->v_x = randrange(1,2);
					r->v_y = randrange(1,2);
					r->ttl = 10; /* how long to live (s) */
					break;
        case 3:
					r->x = randrange(15,400);
					r->y = randrange(250,260);
					r->v_x = randrange(1,2);
					r->v_y = randrange(-1,-2);
					r->ttl = 10; /* how long to live (s) */
					break;
        default:
          r->x = randrange(460,470);
					r->y = randrange(10,260);
					r->v_x = randrange(1,2);
					r->v_y = randrange(1,2);
					r->ttl = 10; /* how long to live (s) */
				break;
     }
	
    
}

/* updateBullets the position of each particle in a list
    of particles
*/
void updateBullets(struct bulletStruct *bullet){
    for( ; bullet ; bullet = bullet->next ) {
        bullet->x += bullet->v_x; 
        bullet->y += bullet->v_y;
        
        
        if( bullet->x<0 || 480<bullet->x ) bullet->ttl=0;
        bullet->ttl -= Dt;
        /* before moving on to the next element,
           check if it is still valid (has steps left)
           I have to do  this now, so I can remove the
           element from the linked-list
        */
        if( bullet->next->ttl<=0 ) {
            struct bulletStruct *expired = bullet->next;
            bullet->next = bullet->next->next;
            freenodeBulletStruct(expired);
        }
    }
}

void updateAsteroids(struct asteroidStruct *asteroid){
    for( ; asteroid ; asteroid = asteroid->next ) {
        asteroid->x += asteroid->v_x; 
        asteroid->y += asteroid->v_y;
        
        // Y Bounce off flick accross different sides of lcd 
        if( asteroid->y > 260 ){
            asteroid->y = 10;
            asteroid->v_y *= 0.5;
        }
				if( asteroid->y < 0 ){
            asteroid->y = 260;
            asteroid->v_y *= -0.5;
        }
		   // x Bounce off flick accross different sides of lcd 
				if( asteroid->x > 470 ){
            asteroid->x = 10;
            asteroid->v_x *= 0.5;
        }
				if( asteroid->x < 10 ){
            asteroid->x = 470;
            asteroid->v_x *= -0.5;
        }

        if( asteroid->next->ttl<=0 ) {
            struct asteroidStruct *expired = asteroid->next;
            asteroid->next = asteroid->next->next;
            freenodeAsteroidStruct(expired);
        }
    }
}

struct bulletStruct *activeBullets = NULL;
struct asteroidStruct *activeAsteroids = NULL;
void draw(void){
        /* with Double-buffering I can just clear the lcd
           and draw everything fresh again
        */
	
	InitialiseStartingBanner();
	
	  if(PlayGameFlag == true){
		 lcd->fillScreen(background);
				drawBanner();
				drawPlayerShip();
        drawBullets(activeBullets);
				drawAsteroids(activeAsteroids);
		}
	

        

        swap_double_buffers();
}

void bullet_system(void){
        struct bulletStruct *spark = allocnodeBullet();
        if(spark) {
            /* put the new particle at the front of the list */
            spark->next = activeBullets;
            activeBullets = spark;
            strikeBullets(spark);
        }

        updateBullets(activeBullets);
}

void asteroid_system(void){
        struct asteroidStruct *spark = allocnodeAsteroid();
        if(spark) {
            /* put the new particle at the front of the list */
            spark->next = activeAsteroids;
            activeAsteroids = spark;
            strikeAsteroids(spark);
        }

        updateAsteroids(activeAsteroids);
}

/* All void . (void) functions */
Ticker particles;
void controls(void){	
 if(jsPrsd(up)){
  Accelarate();    
 }
 else if(jsPrsd(right)){
	 static float RotationAngle = 5;
	 Rotation(RotationAngle);
 }
 else if(jsPrsd(left)){
	 static float RotationAngle = -5;
	 Rotation(RotationAngle);
 }
 else if(jsPrsdAndRlsd(down)){
	Decelarate();
 }
 else if(jsPrsdAndRlsd(centre)){
	 particles.attach(bullet_system, Dt);
	 if(PlayGameFlag == false){
		 StartGame();
   }
	 else if(PlayGameFlag == true){
	   drawBullets(activeBullets);
	 }
 }
} 

void updateAllPositions(){
	asteroid_system();
	bullet_system();
}
int main(){
    initialise_bulletHeap();
		initialise_asteroidHeap();
	
    init_double_buffering();

    drawing.attach(draw, 0.025); 
    asteroidparticles.attach(updateAllPositions, Dt);
	  controller.attach(controls, 0.01);

    while(1) {
        wait(20);
    }
}
